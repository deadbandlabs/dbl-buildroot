## Config.in
```kconfig
# SPDX-License-Identifier: GPL-2.0-or-later
# Copyright 2026 Deadband Inc.
source "$BR2_EXTERNAL_MYD_YF135_PATH/package/Config.in"

config BR2_PACKAGE_DBL_VERIFIED_BOOT
	bool "DBL verified boot"
	select BR2_PACKAGE_DBL_TF_A_MBEDTLS
	select BR2_PACKAGE_DBL_TEE
	select BR2_PACKAGE_OPENSSL
	select BR2_PACKAGE_MTD
	select BR2_PACKAGE_MTD_NANDDUMP
	select BR2_PACKAGE_MTD_NANDWRITE
	select BR2_PACKAGE_MTD_FLASH_ERASE
	select BR2_PACKAGE_LIBGPIOD2
	select BR2_PACKAGE_LIBGPIOD2_TOOLS
	help
	  Adds the verified-boot kernel and U-Boot config fragments on top
	  of the image: configs/myd_yf135_verified.fragment pulls in
	  board/myd-yf135/linux-verified.fragment and uboot-verified.fragment.

	  Builds TF-A with Trusted Board Boot: fip.bin carries certificates
	  signed with the insecure test key. TBB BL2 refuses unsigned FIPs.

	  Builds DBL early TAs into OP-TEE (package/dbl-tee).

	  Set this in a parent fragment directly, not menuconfig.

config BR2_PACKAGE_DBL_FIT_PUBKEYS
	string "FIT signing public keys"
	depends on BR2_PACKAGE_DBL_VERIFIED_BOOT
	help
	  Space-separated paths to X.509 certificates (.crt, RSA-3072).
	  U-Boot boots a rootfs FIT signed by any one of these keys.
	  List a primary and a backup to switch keys.
	  Signing key name = certificate file name without .crt.

	  The build signs with the test key
	  (board/myd-yf135/insecure-test-key/README.md). When empty,
	  U-Boot accepts only that key. Re-sign images with a listed key
	  using sign-rootimg.sh.

config BR2_PACKAGE_DBL_CONSENT
	bool "Consent/programmer build"
	depends on BR2_PACKAGE_DBL_VERIFIED_BOOT
	help
	  Run U-Boot only when the boot pins select USB DFU boot.
	  OP-TEE leaves the SOM EEPROM write-protect pin non-secure.
	  The consent TA reports a consent build.

config BR2_PACKAGE_DBL_CONSENT_BOOT
	bool "Consent session build"
	depends on BR2_PACKAGE_DBL_CONSENT
	help
	  U-Boot boots the factory rootfs instead of the USB programmer.
	  OP-TEE includes the unitkey TA.

config BR2_PACKAGE_DBL_NAND_LOCK
	bool "Lock FSBLs and fip-factory in NAND"
	default y
	depends on BR2_PACKAGE_DBL_VERIFIED_BOOT
	help
	  U-Boot write-protects fsbl1, fsbl2 and fip-factory before
	  Linux starts (uboot-env-nand-lock.txt). Only a power cycle
	  removes the lock: USB DFU flashing after a reset without
	  power-off fails on these partitions.

config BR2_PACKAGE_DBL_VERITY_SIG_CERTS
	string "dm-verity root hash signing certificates"
	depends on BR2_PACKAGE_DBL_VERIFIED_BOOT
	help
	  Path to a PEM file with one or more X.509 certificates (RSA).
	  When set, the kernel checks dm-verity root hash signatures
	  against certificates (CONFIG_DM_VERITY_VERIFY_ROOTHASH_SIG,
	  CONFIG_SYSTEM_TRUSTED_KEYS), e.g. for signed systemd-sysext
	  images.

config BR2_PACKAGE_DBL_RAUC_KEYRING
	string "RAUC keyring"
	help
	  PEM file with the certificates RAUC bundles must chain to,
	  installed as /etc/rauc/keyring.pem.

	  When empty, the test certificate is installed
	  (board/myd-yf135/insecure-test-key/README.md).

config BR2_PACKAGE_DBL_OTP_WRITE
	bool "OTP fuse writes from Linux and U-Boot"
	default y
	help
	  Allows Linux root and U-Boot `fuse prog` to burn OTP fuses
	  (OP-TEE CFG_STM32_BSEC_WRITE). When off, writes are blocked.

	  Use caution with fuse write, changes are permanent and an
	  incorrect fuse can result in a bricked unit.
```

## package/dbl-tee/Config.in
```kconfig
# SPDX-License-Identifier: GPL-2.0-or-later
# Copyright 2026 Deadband Inc.
config BR2_PACKAGE_DBL_TEE
	bool
	depends on BR2_TARGET_OPTEE_OS
	select BR2_PACKAGE_OPTEE_CLIENT
	help
	  DBL early TAs, built into OP-TEE (no TA is loaded from the
	  filesystem), and the dbl-tee command line client:
	  - consent: reports whether OP-TEE is a consent build
	  - deviceid: per-chip attestation key
```

## package/dbl-tf-a-mbedtls/Config.in
```kconfig
# SPDX-License-Identifier: GPL-2.0-or-later
# Copyright 2026 Deadband Inc.
config BR2_PACKAGE_DBL_TF_A_MBEDTLS
	bool
	help
	  Mbed TLS source tree for TF-A Trusted Board Boot (MBEDTLS_DIR).
	  Pinned to the latest 3.6 LTS release, separate from the target
	  mbedtls package.
```
