## configs/myd_yf135_defconfig
```kconfig
## SPDX-License-Identifier: GPL-2.0-or-later
## Copyright 2026 Deadband Inc.
# DBL MYD-YF135-256N-256D (STM32MP135D) defconfig
# SoC:   STM32MP135D (Cortex-A7 single core, up to 1 GHz)
# RAM:   256 MB LPDDR3 @ 0xc0000000
# Flash: 256 MB SPI-NAND (Micron MT29F2G01ABAGDWB via QSPI)
#
# Boot chain: ROM -> TF-A BL2 -> OP-TEE (BL32) -> U-Boot (BL33) -> Linux
# Boot media: SPI-NAND (production); SD card (development/flashing)
#
# All firmware is upstream (buildroot 2025.02 defaults):
#   TF-A v2.12, U-Boot 2025.01, OP-TEE 4.3.0, Linux 6.12
# DTS: out-of-tree under board/myd-yf135/dts/

#
# CPU Architecture: Cortex-A7 with NEON/VFPv4 for math workloads
#
BR2_arm=y
BR2_cortex_a7=y
BR2_ARM_ENABLE_NEON=y
BR2_ARM_ENABLE_VFP=y
BR2_ARM_FPU_NEON_VFPV4=y

#
# Toolchain: internal buildroot glibc
#
BR2_TOOLCHAIN_BUILDROOT_GLIBC=y
BR2_TOOLCHAIN_BUILDROOT_CXX=y
BR2_PACKAGE_HOST_LINUX_HEADERS_CUSTOM_6_12=y
BR2_CCACHE=y
BR2_CCACHE_USE_BASEDIR=y

#
# System
#
BR2_TARGET_GENERIC_HOSTNAME="myd-yf135"
BR2_TARGET_GENERIC_ISSUE="DBL MYD-YF135"
BR2_TARGET_TZ_INFO=y
BR2_TARGET_TZ_INFO_ZONELIST="UTC"
BR2_TARGET_LOCALTIME="UTC"
BR2_INIT_SYSTEMD=y
BR2_ROOTFS_OVERLAY="$(BR2_EXTERNAL_MYD_YF135_PATH)/board/myd-yf135/rootfs-overlay"
BR2_GLOBAL_PATCH_DIR="$(BR2_EXTERNAL_MYD_YF135_PATH)/board/myd-yf135/patches"

#
# Linux kernel: upstream 6.12 LTS
#
BR2_LINUX_KERNEL=y
BR2_LINUX_KERNEL_CUSTOM_VERSION=y
BR2_LINUX_KERNEL_CUSTOM_VERSION_VALUE="6.12.73"
BR2_LINUX_KERNEL_USE_CUSTOM_CONFIG=y
BR2_LINUX_KERNEL_CUSTOM_CONFIG_FILE="$(BR2_EXTERNAL_MYD_YF135_PATH)/board/myd-yf135/linux.config"
BR2_LINUX_KERNEL_UIMAGE=y
BR2_LINUX_KERNEL_UIMAGE_LOADADDR="0xc2000040"
BR2_LINUX_KERNEL_DTS_SUPPORT=y
# Linux 6.12 moved all STM32MP DTS files to arch/arm/boot/dts/st/.
# CUSTOM_DTS_PATH copies to the root dts/ dir, not scanned for STM32MP.
# DTS is copied by LINUX_POST_PATCH_HOOKS in external.mk; Makefile entry
# added via patches/linux/. Edit board/myd-yf135/dts/*.dts directly.
BR2_LINUX_KERNEL_INTREE_DTS_NAME="st/stm32mp135d-myd-yf135"
BR2_LINUX_KERNEL_DTB_OVERLAY_SUPPORT=y
BR2_LINUX_KERNEL_INSTALL_TARGET=y
BR2_LINUX_KERNEL_NEEDS_HOST_OPENSSL=y

#
# TF-A v2.12 (upstream)
# STM32MP13=1:        selects MP13x series (single A7, no M4)
# STM32MP_SPI_NAND=1: SPI-NAND boot via QSPI (production)
# SDMMC boot is enabled only in debug fragment for bring-up/recovery.
# !! TRUSTED_BOARD_BOOT / GENERATE_COT currently omitted !!
# requires mbedtls source tree at build time; re-enable once key infrastructure is ready
# TODO: See board/myd-yf135/README.secure-boot
#
BR2_TARGET_ARM_TRUSTED_FIRMWARE=y
BR2_TARGET_ARM_TRUSTED_FIRMWARE_LATEST_VERSION=y
BR2_TARGET_ARM_TRUSTED_FIRMWARE_PLATFORM="stm32mp1"
BR2_TARGET_ARM_TRUSTED_FIRMWARE_CUSTOM_DTS_PATH="$(BR2_EXTERNAL_MYD_YF135_PATH)/board/myd-yf135/dts/stm32mp135d-myd-yf135-tf-a.dts $(BR2_EXTERNAL_MYD_YF135_PATH)/board/myd-yf135/dts/stm32mp135d-myd-yf135-tf-a.dtsi $(BR2_EXTERNAL_MYD_YF135_PATH)/board/myd-yf135/dts/stm32mp135d-myd-yf135-tf-a-fw-config.dts"
BR2_TARGET_ARM_TRUSTED_FIRMWARE_FIP=y
BR2_TARGET_ARM_TRUSTED_FIRMWARE_BL32_OPTEE=y
BR2_TARGET_ARM_TRUSTED_FIRMWARE_UBOOT_AS_BL33=y
BR2_TARGET_ARM_TRUSTED_FIRMWARE_ADDITIONAL_VARIABLES="STM32MP13=1 STM32MP_SPI_NAND=1 STM32MP_USB_PROGRAMMER=1 AARCH32_SP=optee LOG_LEVEL=0 DTB_FILE_NAME=stm32mp135d-myd-yf135-tf-a.dtb BL33_CFG=$(BINARIES_DIR)/u-boot.dtb AS=$(TARGET_CROSS)gcc OPENSSL_DIR=$(BR2_HOST_DIR)"
BR2_TARGET_ARM_TRUSTED_FIRMWARE_IMAGES="*.stm32 fip.bin"
BR2_TARGET_ARM_TRUSTED_FIRMWARE_NEEDS_DTC=y

#
# OP-TEE 4.3.0 (upstream)
# CFG_DRAM_SIZE=0x10000000 (256 MB)
# Reserved memory (from DTS): optee @ 0xce000000 (32 MB), fb @ 0xcd000000 (16 MB)
#
BR2_TARGET_OPTEE_OS=y
BR2_TARGET_OPTEE_OS_LATEST=y
BR2_TARGET_OPTEE_OS_NEEDS_DTC=y
BR2_TARGET_OPTEE_OS_NEEDS_PYTHON_CRYPTOGRAPHY=y
BR2_TARGET_OPTEE_OS_PLATFORM="stm32mp1"
BR2_TARGET_OPTEE_OS_CUSTOM_DTS_PATH="$(BR2_EXTERNAL_MYD_YF135_PATH)/board/myd-yf135/dts/stm32mp135d-myd-yf135-optee.dts"
BR2_TARGET_OPTEE_OS_ADDITIONAL_VARIABLES="CFG_EMBED_DTB_SOURCE_FILE=stm32mp135d-myd-yf135-optee.dts CFG_STM32MP13=y CFG_WITH_TUI=n CFG_TEE_CORE_LOG_LEVEL=0 CFG_DRAM_SIZE=0x10000000 CFG_SHMEM_SIZE=0x200000 STM32MP_USB_PROGRAMMER=1"

#
# U-Boot bleeding-edge (upstream master, for patch testing)
# Switch back to BR2_TARGET_UBOOT_LATEST_VERSION=y once patch is accepted.
#
BR2_TARGET_UBOOT=y
BR2_TARGET_UBOOT_BUILD_SYSTEM_KCONFIG=y
BR2_TARGET_UBOOT_CUSTOM_GIT=y
BR2_TARGET_UBOOT_CUSTOM_REPO_URL="https://source.denx.de/u-boot/u-boot.git"
BR2_TARGET_UBOOT_CUSTOM_REPO_VERSION="master"
BR2_TARGET_UBOOT_BOARD_DEFCONFIG="stm32mp13"
BR2_TARGET_UBOOT_NEEDS_PYLIBFDT=y
BR2_TARGET_UBOOT_NEEDS_OPENSSL=y
BR2_TARGET_UBOOT_FORMAT_DTB=y
BR2_TARGET_UBOOT_CONFIG_FRAGMENT_FILES="$(BR2_EXTERNAL_MYD_YF135_PATH)/board/myd-yf135/uboot.config"
BR2_TARGET_UBOOT_CUSTOM_MAKEOPTS="DEVICE_TREE=stm32mp135d-myd-yf135"

#
# Filesystem: UBIFS on UBI on SPI-NAND
# UBI partition: 0x1200000..end = 0xee00000 bytes = 1904 × 128KB blocks
# Micron MT29F2G01ABAGDWB: page=2KB, block=128KB, no sub-pages
#   PEB  = 131072 (0x20000)
#   LEB  = PEB - 2×page = 131072 - 4096 = 126976 (0x1f000)
#   Max LEB count = 1904 blocks - ~20 UBI overhead = 1884
#
BR2_TARGET_ROOTFS_UBIFS=y
BR2_TARGET_ROOTFS_UBIFS_LEBSIZE=126976
BR2_TARGET_ROOTFS_UBIFS_MINIOSIZE=2048
BR2_TARGET_ROOTFS_UBIFS_MAXLEBCNT=1884
BR2_TARGET_ROOTFS_UBIFS_OPTS="-x zstd"
BR2_TARGET_ROOTFS_UBI=y
BR2_TARGET_ROOTFS_UBI_USE_CUSTOM_CONFIG=y
BR2_TARGET_ROOTFS_UBI_CUSTOM_CONFIG_FILE="$(BR2_EXTERNAL_MYD_YF135_PATH)/board/myd-yf135/ubinize.cfg"
BR2_TARGET_ROOTFS_UBI_PEBSIZE=131072
BR2_TARGET_ROOTFS_UBI_SUBSIZE=0
# BR2_TARGET_ROOTFS_TAR is not set

#
# Host tools
#
BR2_PACKAGE_HOST_GENIMAGE=y
BR2_PACKAGE_HOST_PYTHON3=y
BR2_PACKAGE_HOST_UBOOT_TOOLS_FIT_SUPPORT=y

#
# Target packages, minimal base; USB and math libs to be added
#
BR2_PACKAGE_MTD=y
BR2_PACKAGE_OPTEE_CLIENT=y
```

## configs/myd_yf135_toolchain_defconfig
```kconfig
# SPDX-License-Identifier: GPL-2.0-or-later
# Copyright 2026 Deadband Inc.
#
# Toolchain-only defconfig for the split nix build without target packages
#
# Lines select which symbols/keys are tracked, and is normally updated
# automatically by check-toolchain-defconfig.sh (make regen-toolchain-defconfig)
BR2_arm=y
BR2_cortex_a7=y
BR2_ARM_ENABLE_NEON=y
BR2_ARM_ENABLE_VFP=y
BR2_ARM_FPU_NEON_VFPV4=y
BR2_TOOLCHAIN_BUILDROOT_GLIBC=y
BR2_TOOLCHAIN_BUILDROOT_CXX=y
BR2_PACKAGE_HOST_LINUX_HEADERS_CUSTOM_6_12=y
```

## support/parent/template/overlay/Config.in
```kconfig
# SPDX-License-Identifier: GPL-2.0-or-later
# Copyright @@COPYRIGHT_YEAR@@ @@COPYRIGHT_HOLDER@@
source "$BR2_EXTERNAL_@@PROJECT_NAME_UPPER@@_PATH/package/Config.in"
```
